## components/custom-header/Kconfig
```kconfig
config FOO_ENABLE_BAR
    bool "Enable the BAR feature."
    help
        This enables the BAR feature of the FOO component.
        
```

## sdkconfig.defaults
```kconfig
CONFIG_AUTOSTART_ARDUINO=y
# CONFIG_WS2812_LED_ENABLE is not set
CONFIG_FREERTOS_HZ=1000
CONFIG_MBEDTLS_PSK_MODES=y
CONFIG_MBEDTLS_KEY_EXCHANGE_PSK=y
CONFIG_BT_ENABLED=y
CONFIG_BT_SOC_SUPPORT_5_0=y
CONFIG_BT_NIMBLE_ENABLED=y
CONFIG_ESP_TASK_WDT=n
CONFIG_ESP_INT_WDT=n

#CONF_ESP32S3_SPIRAM_SUPPORT=y
#CONF_SPIRAM=y

CONFIG_BT_NIMBLE_TASK_STACK_SIZE=16384
CONFIG_BT_NIMBLE_MEM_ALLOC_MODE_EXTERNAL=y
CONFIG_BT_NIMBLE_MEM_ALLOC_MODE_INTERNAL=n
CONFIG_BT_NIMBLE_LOG_LEVEL_WARNING=y

CONFIG_NIMBLE_CPP_LOG_LEVEL_ERROR=y
# y breaks things big time
CONFIG_ARDUINO_ISR_IRAM=n

CONFIG_BT_NIMBLE_ROLE_CENTRAL=n
CONFIG_BT_NIMBLE_ROLE_PERIPHERAL=y
CONFIG_BT_NIMBLE_ROLE_BROADCASTER=y
CONFIG_BT_NIMBLE_ROLE_OBSERVER=n


#for BLE5.0 multiadvertiser example
# Override some defaults so BT stack is enabled
# in this example

#
# BT config
#
CONFIG_BTDM_CTRL_MODE_BLE_ONLY=y
CONFIG_BTDM_CTRL_MODE_BR_EDR_ONLY=n
CONFIG_BTDM_CTRL_MODE_BTDM=n
CONFIG_BT_BLUEDROID_ENABLED=n
#CONFIG_BT_NIMBLE_EXT_ADV=y
```

## src/Kconfig.projbuild
```kconfig
menu "ESP-NimBLE-CPP configuration"

choice NIMBLE_CPP_LOG_LEVEL
    prompt "NimBLE CPP log verbosity"
    default NIMBLE_CPP_LOG_LEVEL_NONE
    help
        Select NimBLE CPP log verbosity level.

    config NIMBLE_CPP_LOG_LEVEL_NONE
        bool "No logs"
    config NIMBLE_CPP_LOG_LEVEL_ERROR
        bool "Error logs"
    config NIMBLE_CPP_LOG_LEVEL_WARNING
        bool "Warning logs"
    config NIMBLE_CPP_LOG_LEVEL_INFO
        bool "Info logs"
    config NIMBLE_CPP_LOG_LEVEL_DEBUG
        bool "Debug logs"
endchoice #NIMBLE_CPP_LOG_LEVEL

config NIMBLE_CPP_LOG_LEVEL
    int
    default 0 if NIMBLE_CPP_LOG_LEVEL_NONE
    default 1 if NIMBLE_CPP_LOG_LEVEL_ERROR
    default 2 if NIMBLE_CPP_LOG_LEVEL_WARNING
    default 3 if NIMBLE_CPP_LOG_LEVEL_INFO
    default 4 if NIMBLE_CPP_LOG_LEVEL_DEBUG

config NIMBLE_CPP_ENABLE_RETURN_CODE_TEXT
    bool "Show NimBLE return codes as text in debug log."
    default "n"
    help
        Enabling this option will display return code values as text
        messages in the debug log. This will use approximately 8kB
        of flash memory.
        
config NIMBLE_CPP_ENABLE_GAP_EVENT_CODE_TEXT
    bool "Show NimBLE gap events as text in debug log."
    default "n"
    help
        Enabling this option will display gap event codes as text
        messages in the debug log. This will use approximately 1kB
        of flash memory.

config NIMBLE_CPP_ENABLE_ADVERTISEMENT_TYPE_TEXT
    bool "Show advertisment types as text in debug log."
    default "n"
    help
        Enabling this option will display advertisment types recieved
        while scanning as text messages in the debug log. 
        This will use approximately 250 bytes of flash memory.

config NIMBLE_CPP_ATT_VALUE_TIMESTAMP_ENABLED
    bool "Enable timestamps to be stored with attribute values."
    default "n"
    help
        Enabling this option will store the timestamp when an attribute value is updated.
        This allows for checking the last update time using getTimeStamp()
        or getValue(time_t*). If disabled, the timestamp returned from these functions will be 0.
        Disabling timestamps will reduce the memory used for each value.

config NIMBLE_CPP_ATT_VALUE_INIT_LENGTH
    int "Initial attribute value size (bytes) for empty values."
    range 1 512
    default 20
    help
        Sets the default allocation size (bytes) for each attribute if not specified
        when the constructor is called. This is also the size used when a remote
        characteristic or descriptor is constructed before a value is read/notifed.
        Increasing this will reduce reallocations but increase memory footprint.
        
endmenu

menu "I2C"

config I2CDEV_TIMEOUT
    int "I2C transaction timeout, milliseconds"
    default 1000
    range 10 5000
    
config I2CDEV_NOLOCK
	bool "Disable the use of mutexes"
	default n
	help
		Attention! After enabling this option, all I2C device
		drivers will become non-thread safe. 
		Use this option if you need to access your I2C devices
		from interrupt handlers. 
    
endmenu

menu "Example configuration"

    config EXAMPLE_I2C_MASTER_SCL
        int "SCL GPIO Number"
        default 5 if IDF_TARGET_ESP8266
        default 6 if IDF_TARGET_ESP32C3
        default 19 if IDF_TARGET_ESP32 || IDF_TARGET_ESP32S2 || IDF_TARGET_ESP32S3
        help
            GPIO number for I2C Master clock line.

    config EXAMPLE_I2C_MASTER_SDA
        int "SDA GPIO Number"
        default 4 if IDF_TARGET_ESP8266
        default 5 if IDF_TARGET_ESP32C3
        default 18 if IDF_TARGET_ESP32 || IDF_TARGET_ESP32S2 || IDF_TARGET_ESP32S3
        help
            GPIO number for I2C Master data line.

endmenu
```
